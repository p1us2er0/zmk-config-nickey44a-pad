## boards/shields/nickey44a/dts/bindings/behaviors/zmk,behavior-layer-morph.yaml
```yaml
# Implemented in src/behavior_layer_morph.c.
description: |
  Invokes the second of two bindings while any of the given layers is
  active, and the first one otherwise.

compatible: "zmk,behavior-layer-morph"

include: zero_param.yaml

properties:
  bindings:
    type: phandle-array
    required: true
  layers:
    type: array
    required: true
    description: Layers that select the second binding.
```

## boards/shields/nickey44a/dts/bindings/input/processor/input-processor-pinch-zoom.yaml
```yaml
# Implemented in src/input_processor_pinch_zoom.c.
description: |
  Turns a trackpad's pinch amount into zoom keys: in-keycode for each
  threshold of spreading the fingers, out-keycode for each threshold of
  closing them. Drops cursor movement for the rest of a touch that pinched.
  While reset-layer is active, reset-code taps reset-keycode instead.

compatible: "zmk,input-processor-pinch-zoom"

include: ip_zero_param.yaml

properties:
  zoom-code:
    type: int
    default: 0x09
    description: Event code of the pinch amount. The TPS43 driver uses INPUT_REL_MISC.
  touch-code:
    type: int
    required: true
    description: Key event code for touch down and up, such as INPUT_BTN_TOUCH.
  threshold:
    type: int
    required: true
    description: Pinch amount per zoom key.
  in-keycode:
    type: int
    required: true
    description: ZMK keycode for spreading the fingers (zoom in).
  out-keycode:
    type: int
    required: true
    description: ZMK keycode for closing the fingers (zoom out).
  reset-code:
    type: int
    default: 0x101
    description: >-
      Key event code that resets the zoom while reset-layer is active. The
      TPS43 driver reports a two-finger tap as INPUT_BTN_1.
  reset-layer:
    type: int
    default: -1
    description: Layer during which reset-code resets the zoom. -1 turns this off.
  reset-keycode:
    type: int
    default: 0
    description: ZMK keycode that resets the zoom to the normal size.
```

## boards/shields/nickey44a/dts/bindings/input/processor/input-processor-touch-swipe.yaml
```yaml
# Bundled binding mirror; keep identical to the standalone touch-swipe binding.
description: One horizontal swipe per complete touch, with configurable ZMK keycodes
compatible: "zmk,input-processor-touch-swipe"
include: ip_zero_param.yaml
properties:
  hwheel-code:
    type: int
    required: true
  wheel-code:
    type: int
    required: true
  touch-code:
    type: int
    required: true
  threshold:
    type: int
    default: 8
    description: Positive minimum net horizontal wheel units.
  axis-ratio:
    type: int
    default: 2
    description: Positive horizontal magnitude to total vertical travel ratio.
  left-keycode:
    type: int
    default: 0
    description: >-
      Encoded ZMK keycode tapped on a negative horizontal swipe. Leave both
      base keycodes 0 to let horizontal scrolling through unless an override
      layer is active.
  right-keycode:
    type: int
    default: 0
    description: Encoded ZMK keycode tapped on a positive horizontal swipe.
  override-layer:
    type: int
    default: -1
    description: Layer ID selecting alternate keycodes at swipe recognition; -1 disables.
  override-left-keycode:
    type: int
    default: 0
    description: Encoded keycode for a negative swipe when override-layer is active.
  override-right-keycode:
    type: int
    default: 0
    description: Encoded keycode for a positive swipe when override-layer is active.
  second-override-layers:
    type: array
    description: >-
      Layer IDs selecting the second override keycodes at swipe recognition
      when override-layer is not active. Any one active layer is enough.
  second-override-left-keycode:
    type: int
    default: 0
    description: Encoded keycode for a negative swipe when a second override layer is active.
  second-override-right-keycode:
    type: int
    default: 0
    description: Encoded keycode for a positive swipe when a second override layer is active.
  second-override-hold-keycode:
    type: int
    default: 0
    description: |
      Encoded keycode pressed by a swipe while a second override layer is
      active and held until the finger lifts, such as LEFT_GUI for an app
      switcher. While it is held, each further repeat threshold of travel in
      the same touch sends the second override keycode for its direction.
      0 keeps one swipe per touch.
  second-override-repeat-threshold:
    type: int
    default: 0
    description: |
      Horizontal travel per extra key while second-override-hold-keycode is
      held. 0 uses threshold.
```

## boards/shields/nickey44a/dts/bindings/zmk,profile-layers.yaml
```yaml
# Implemented in src/profile_layers.c.
description: |
  Turns layers on and off by the active Bluetooth profile, shortly after
  startup and whenever the active profile changes. Each child lists the
  layers for one profile; the other managed layers are turned off. A
  profile without a child turns all of them off.

compatible: "zmk,profile-layers"

properties:
  layers:
    type: array
    required: true
    description: Layers set by profile.

child-binding:
  description: Layers for one Bluetooth profile.
  properties:
    profile:
      type: int
      required: true
      description: Profile index, from 0.
    layers:
      type: array
      required: true
      description: Layers that are on while this profile is active.
```
